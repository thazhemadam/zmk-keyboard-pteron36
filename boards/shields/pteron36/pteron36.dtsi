#include "pteron36-matrix.dtsi"
#include "pteron36-layout.dtsi"

&pteron36_all_thumbs {
    transform = <&pteron36_3x5_4>;
};

/ {
    chosen {
        zmk,kscan = &kscan0;
        zmk,physical-layout = &pteron36_all_thumbs;
    };

    kscan0: kscan {
        compatible = "zmk,kscan-gpio-matrix";
        diode-direction = "col2row";
        wakeup-source;
        row-gpios
            = <&pro_micro 7 (GPIO_ACTIVE_HIGH | GPIO_PULL_DOWN)>
            , <&pro_micro 6 (GPIO_ACTIVE_HIGH | GPIO_PULL_DOWN)>
            , <&pro_micro 8 (GPIO_ACTIVE_HIGH | GPIO_PULL_DOWN)>
            , <&pro_micro 9 (GPIO_ACTIVE_HIGH | GPIO_PULL_DOWN)>
            ;
    };
};
